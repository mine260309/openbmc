## meta-ibm/meta-romulus/conf/distro/openbmc-romulus.conf
```bitbake
require conf/distro/openbmc-openpower.conf
require conf/distro/include/phosphor-isolation.inc
require conf/distro/include/phosphor-tiny.inc
```
